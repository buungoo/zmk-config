// lily58.keymap
#define CONFIG_WIRELESS
#define ZMK_BASE_LAYER(name, LT, RT, LM, RM, LB, RB, LH, RH) \
    ZMK_LAYER(                                                \
        name,                                                 \
                 LT RT                                        \
                 LM RM                                        \
                 LB RB                                        \
        &kp LGUI LH RH &smart_mouse                           \
    )

// Use 36-key labels
#include "zmk-helpers/key-labels/36.h" 

// Inherit base config
#include "base.keymap"

// Physical layout (if needed)
/{ chosen { zmk,physical-layout = &lily58_layout; }; };
